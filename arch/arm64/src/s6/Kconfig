## arch/arm64/src/s6/Kconfig
```kconfig
#
# arch/arm64/src/s6/Kconfig
#

if ARCH_CHIP_S6

menu "Amlogic Meson S6 Peripheral Selection"

config S6_UART
	bool "Amlogic Meson UART"
	default y
	select UART0_SERIALDRIVER
	select ARCH_HAVE_SERIAL_TERMIOS
	---help---
		Enable the Meson S6 UART-B lower-half and console support.

config S6_UART0_BASE
	hex "S6 UART-B base address"
	default 0xfe07a000

config S6_UART0_IRQ
	int "S6 UART-B IRQ"
	default 201

config S6_MIPI_DSI
	bool "MIPI DSI display (U-Boot initialized)"
	depends on VIDEO_FB
	select FB_UPDATE
	---help---
		Enable the Meson S6 MIPI DSI lower-half.  U-Boot performs the
		display bring-up (panel power, DSI host, D-PHY, VENC timing)
		before booting NuttX, so this driver only re-points the OSD1
		plane at a NuttX-owned framebuffer and registers /dev/fb0.
		The DSI link itself is never re-initialized.

config S6_FB_WIDTH
	int "Panel width in pixels"
	depends on S6_MIPI_DSI
	range 1 4096
	default 1080
	---help---
		Native horizontal resolution of the panel that U-Boot
		programmed.  The framebuffer is 1:1, no scaling.

config S6_FB_HEIGHT
	int "Panel height in pixels"
	depends on S6_MIPI_DSI
	range 1 4096
	default 1920
	---help---
		Native vertical resolution of the panel that U-Boot
		programmed.  The framebuffer is 1:1, no scaling.

config S6_GPIO
	bool "Amlogic Meson GPIO and GPIO interrupt controller"
	default n
	---help---
		Enable minimal GPIO support for the periphs GPIOA bank and
		the GPIO interrupt controller (12 channels mapped to GIC
		SPIs 10-21).

config S6_I2C
	bool "Amlogic Meson I2C master"
	default n
	select I2C
	---help---
		Enable the Meson S6 I2C master lower-half.

config S6_I2C0_BASE
	hex "S6 I2C0 base address"
	depends on S6_I2C
	default 0xfe066000

config S6_I2C0_IRQ
	int "S6 I2C0 IRQ"
	depends on S6_I2C
	default 192

config S6_I2C_CLK_HZ
	int "sys_clk frequency feeding the I2C dividers (Hz)"
	depends on S6_I2C
	default 167000000
	---help---
		The I2C masters are clocked from sys_clk whose rate is
		installed by BL31.

endmenu # Amlogic Meson S6 Peripheral Selection

endif # ARCH_CHIP_S6
```
